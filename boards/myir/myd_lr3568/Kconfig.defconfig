## boards/myir/myd_lr3568/Kconfig.myd_lr3568
```kconfig
# SPDX-FileCopyrightText: Copyright The Zephyr Project Contributors
# SPDX-License-Identifier: Apache-2.0

config BOARD_MYD_LR3568
	select SOC_RK3568
```

## boards/myir/myd_lr3568/board.yml
```yaml
board:
  name: myd_lr3568
  full_name: MYiR MYD-LR3568
  vendor: myir
  socs:
  - name: rk3568
    variants:
    - name: smp
```

## drivers/adc/Kconfig.rockchip
```kconfig
# SPDX-FileCopyrightText: Copyright The Zephyr Project Contributors
# SPDX-License-Identifier: Apache-2.0

config ADC_ROCKCHIP_SARADC
	bool "Rockchip SARADC driver"
	default y
	depends on DT_HAS_ROCKCHIP_RK3568_SARADC_ENABLED
	help
	  Enable the driver for the 10-bit successive approximation ADC of
	  Rockchip RK3568 & related SoCs.
```

## drivers/gpio/Kconfig.rockchip
```kconfig
# SPDX-FileCopyrightText: Copyright The Zephyr Project Contributors
# SPDX-License-Identifier: Apache-2.0

config GPIO_ROCKCHIP
	bool "Rockchip GPIO driver"
	default y
	depends on DT_HAS_ROCKCHIP_GPIO_BANK_ENABLED
	select PINCTRL if $(dt_compat_any_has_prop,$(DT_COMPAT_ROCKCHIP_GPIO_BANK),pinctrl-0)
	help
	  Enable the driver for the Rockchip GPIO controller (version 2),
	  found on RK356x and RK3588 SoCs.
```

## drivers/i2c/Kconfig.rockchip
```kconfig
# SPDX-FileCopyrightText: Copyright The Zephyr Project Contributors
# SPDX-License-Identifier: Apache-2.0

config I2C_ROCKCHIP
	bool "Rockchip I2C controller driver"
	default y
	depends on DT_HAS_ROCKCHIP_RK3568_I2C_ENABLED
	select PINCTRL
	help
	  Enable the polled driver for the I2C controller of Rockchip RK3568
	  & related SoCs.
```

## drivers/pinctrl/Kconfig.rockchip
```kconfig
# SPDX-FileCopyrightText: Copyright The Zephyr Project Contributors
# SPDX-License-Identifier: Apache-2.0

config PINCTRL_ROCKCHIP
	bool "Rockchip RK3568 pin controller driver"
	default y
	depends on DT_HAS_ROCKCHIP_RK3568_PINCTRL_ENABLED
	help
	  Enable the pin controller driver for the Rockchip RK3568: IOMUX, pull
	  & drive strength.
```

## drivers/pwm/Kconfig.rockchip
```kconfig
# SPDX-FileCopyrightText: Copyright The Zephyr Project Contributors
# SPDX-License-Identifier: Apache-2.0

config PWM_ROCKCHIP
	bool "Rockchip PWM driver"
	default y
	depends on DT_HAS_ROCKCHIP_RK3568_PWM_ENABLED
	select PINCTRL
	help
	  Enable the driver for the PWM channels of Rockchip RK3568 & related
	  SoCs.
```

## drivers/reset/Kconfig.rockchip
```kconfig
# SPDX-FileCopyrightText: Copyright (c) 2026 KylinSoft Corporation
# SPDX-License-Identifier: Apache-2.0

config RESET_ROCKCHIP_RK3588
	bool "Rockchip RK3588 CRU reset controller"
	default y
	depends on DT_HAS_ROCKCHIP_RK3588_CRU_RST_ENABLED
	help
	  Enable reset control for the Rockchip RK3588 CRU.

config RESET_ROCKCHIP_RK3568
	bool "Rockchip RK3568 CRU reset controller"
	default y
	depends on DT_HAS_ROCKCHIP_RK3568_CRU_ENABLED
	help
	  Enable the driver for the soft resets of the Rockchip RK3568 clock &
	  reset unit (CRU).
```

## drivers/sensor/rockchip/Kconfig
```kconfig
# SPDX-FileCopyrightText: Copyright The Zephyr Project Contributors
# SPDX-License-Identifier: Apache-2.0

source "drivers/sensor/rockchip/rockchip_tsadc/Kconfig"
```

## drivers/sensor/rockchip/rockchip_tsadc/Kconfig
```kconfig
# SPDX-FileCopyrightText: Copyright The Zephyr Project Contributors
# SPDX-License-Identifier: Apache-2.0

config ROCKCHIP_TSADC
	bool "Rockchip TSADC temperature sensor"
	default y
	depends on DT_HAS_ROCKCHIP_RK3568_TSADC_ENABLED
	select RESET
	help
	  Enable the Rockchip RK3568 TSADC, which measures the SoC temperature
	  at the CPU & GPU.
```

## drivers/spi/Kconfig.rockchip
```kconfig
# SPDX-FileCopyrightText: Copyright The Zephyr Project Contributors
# SPDX-License-Identifier: Apache-2.0

config SPI_ROCKCHIP
	bool "Rockchip SPI controller driver"
	default y
	depends on DT_HAS_ROCKCHIP_RK3568_SPI_ENABLED
	select PINCTRL
	select RESET
	help
	  Enable the Rockchip RK3568 SPI controller driver (controller mode,
	  polled).
```

## dts/bindings/adc/rockchip,rk3568-saradc.yaml
```yaml
# SPDX-FileCopyrightText: Copyright The Zephyr Project Contributors
# SPDX-License-Identifier: Apache-2.0

description: |
  Rockchip RK3568 SARADC, the RK3399 generation of the Rockchip successive
  approximation ADC: 8 single-ended channels, 10 bits, one reference input.

compatible: "rockchip,rk3568-saradc"

include: adc-controller.yaml

properties:
  reg:
    required: true

  interrupts:
    required: true

  vref-mv:
    type: int
    required: true
    description: Voltage on the reference input (VCCA_1V8 on RK3568 boards) in mV.

  "#io-channel-cells":
    const: 1

io-channel-cells:
  - input
```

## dts/bindings/ethernet/phy/motorcomm,yt8521.yaml
```yaml
# Copyright 2025 NXP
# SPDX-License-Identifier: Apache-2.0

description: Motorcomm YT8521 Ethernet PHY

compatible: "motorcomm,yt8521"

include: ethernet-phy-common.yaml

properties:
  reset-gpios:
    type: phandle-array
    description: |
      GPIO wired to the PHY's RESET_N pin, usually flagged GPIO_ACTIVE_LOW.
      The driver holds it in reset for 20 ms, then waits 100 ms.
  motorcomm,rx-delay-sel:
    type: int
    description: |
      RGMII RX_CLK delay train configuration, about 150ps per step.
      See RGMII_Config1 (EXT_0xA003) register for details
  motorcomm,tx-delay-sel:
    type: int
    description: |
      RGMII RX_CLK delay train configuration, about 150ps per step.
      See RGMII_Config1 (EXT_0xA003) register for details
  default-speeds:
    default: ["10BASE Half-Duplex", "10BASE Full-Duplex", "100BASE Half-Duplex",
              "100BASE Full-Duplex", "1000BASE Half-Duplex", "1000BASE Full-Duplex"]
```

## dts/bindings/ethernet/rockchip,rk3568-gmac.yaml
```yaml
# SPDX-FileCopyrightText: Copyright The Zephyr Project Contributors
# SPDX-License-Identifier: Apache-2.0

description: |
  Rockchip RK3568 GMAC, a Synopsys DesignWare Ethernet QoS MAC, in RGMII mode
  with the clock delays in the MAC (phy-connection-type "rgmii").

compatible: "rockchip,rk3568-gmac"

include: ["snps,dwmac.yaml", pinctrl-device.yaml, reset-device.yaml]

properties:
  reg:
    required: true

  interrupts:
    required: true

  resets:
    required: true

  pinctrl-0:
    required: true

  pinctrl-names:
    required: true

  phy-connection-type:
    required: true

  rockchip,grf:
    type: phandle
    required: true
    description: General register files, which hold the RGMII mode & delays.

  tx-delay:
    type: int
    default: 0x30
    description: TX clock delay line setting (0 turns the delay line off).

  rx-delay:
    type: int
    default: 0x10
    description: RX clock delay line setting (0 turns the delay line off).
```

## dts/bindings/gpio/rockchip,gpio-bank.yaml
```yaml
# SPDX-FileCopyrightText: Copyright The Zephyr Project Contributors
# SPDX-License-Identifier: Apache-2.0

description: |
  Rockchip GPIO controller, version 2 (RK356x, RK3588).

  Each bank has 32 pins, A0-D7. Pull-up/down and drive strength live in
  the GRF, not in this controller: set them with a pinctrl-0 state, which
  the driver applies at init.

compatible: "rockchip,gpio-bank"

include: [gpio-controller.yaml, base.yaml, pinctrl-device.yaml]

properties:
  reg:
    required: true

  interrupts:
    required: true

  "#gpio-cells":
    const: 2

gpio-cells:
  - pin
  - flags
```

## dts/bindings/i2c/rockchip,rk3568-i2c.yaml
```yaml
# SPDX-FileCopyrightText: Copyright The Zephyr Project Contributors
# SPDX-License-Identifier: Apache-2.0

description: |
  Rockchip RK3568 I2C controller, the RK3399 generation of the Rockchip I2C
  block, run as an interrupt-driven controller.

compatible: "rockchip,rk3568-i2c"

include: [i2c-controller.yaml, pinctrl-device.yaml]

properties:
  reg:
    required: true

  interrupts:
    required: true

  clocks:
    required: true
    description: |
      Function clock, as a fixed-clock node whose clock-frequency the driver
      divides down to the bus rate.
```

## dts/bindings/pinctrl/rockchip,rk3568-pinctrl.yaml
```yaml
# SPDX-FileCopyrightText: Copyright The Zephyr Project Contributors
# SPDX-License-Identifier: Apache-2.0

description: |
  Rockchip RK3568 pin controller.

  IOMUX, pull & drive strength of the GPIO0 pins live in the PMU GRF; those of
  GPIO1-GPIO4 in the system GRF.

  Pins are grouped by state, then by shared configuration:

    #include <zephyr/dt-bindings/pinctrl/rockchip-pinctrl.h>

    &pinctrl {
      uart2m0_xfer: uart2m0-xfer {
        group0 {
          pinmux = <RK_PINMUX(0, RK_PD0, 1)>, <RK_PINMUX(0, RK_PD1, 1)>;
          bias-pull-up;
        };
      };
    };

  A property left out leaves that setting as the boot loader set it.

  A peripheral with more than one pin set (M0, M1, M2) also needs its route
  register set: encode the pins with RK_PINMUX_ROUTE(bank, pin, function,
  register, shift, width, value), where register is RK_IOFUNC_SEL0-5 (GRF
  0x0300-0x0314) or RK_ROUTE_PMU_0110, & shift, width & value give the
  peripheral's field in it, from the TRM. For example, GMAC1 M1 sets bit 8 of
  IOFUNC_SEL0:

    pinmux = <RK_PINMUX_ROUTE(4, RK_PA7, 3, RK_IOFUNC_SEL0, 8, 1, 1)>;

compatible: "rockchip,rk3568-pinctrl"

include: base.yaml

properties:
  reg:
    required: true
    description: PMU GRF, then system GRF.

  reg-names:
    required: true

child-binding:
  description: Pin configuration state.

  child-binding:
    description: Pins sharing one configuration.

    include:
      - name: pincfg-node.yaml
        property-allowlist:
          - bias-disable
          - bias-pull-down
          - bias-pull-up
          - drive-strength

    properties:
      pinmux:
        type: array
        required: true
        description: |
          Pins, each encoded with RK_PINMUX(bank, pin, function), or with
          RK_PINMUX_ROUTE() to also select the peripheral's pin set.
          drive-strength is a level, 0 (weakest) to 5, not milliamps.
```

## dts/bindings/pwm/rockchip,rk3568-pwm.yaml
```yaml
# SPDX-FileCopyrightText: Copyright The Zephyr Project Contributors
# SPDX-License-Identifier: Apache-2.0

description: |
  Rockchip RK3568 PWM channel, the RK3328 generation of the Rockchip PWM. Each
  node is one channel of a four-channel block, so the channel cell is 0.

compatible: "rockchip,rk3568-pwm"

include: [pwm-controller.yaml, pinctrl-device.yaml, base.yaml]

properties:
  reg:
    required: true

  clocks:
    required: true
    description: |
      Function clock, as a fixed-clock node whose clock-frequency is the
      counter rate.

  "#pwm-cells":
    const: 3

pwm-cells:
  - channel
  - period
  - flags
```

## dts/bindings/reset/rockchip,rk3568-cru.yaml
```yaml
# SPDX-FileCopyrightText: Copyright The Zephyr Project Contributors
# SPDX-License-Identifier: Apache-2.0

description: |
  Rockchip RK3568 clock & reset unit (CRU), as a reset controller for its
  soft resets. Reset ids are those of Linux, in
  zephyr/dt-bindings/reset/rockchip-rk3568-reset.h.

compatible: "rockchip,rk3568-cru"

include: [base.yaml, reset-controller.yaml]

properties:
  reg:
    required: true

  "#reset-cells":
    const: 1

reset-cells:
  - id
```

## dts/bindings/sensor/rockchip,rk3568-tsadc.yaml
```yaml
# SPDX-FileCopyrightText: Copyright The Zephyr Project Contributors
# SPDX-License-Identifier: Apache-2.0

description: |
  Rockchip RK3568 TSADC: the on-die temperature sensors at the CPU (read as
  SENSOR_CHAN_DIE_TEMP) & the GPU (SENSOR_CHAN_ROCKCHIP_TSADC_GPU).

  The driver sets the TSADC clocks in the CRU that owns the resets. The
  hardware shutdown output (TSHUT) is not used.

compatible: "rockchip,rk3568-tsadc"

include: [sensor-device.yaml, reset-device.yaml]

properties:
  reg:
    required: true

  resets:
    required: true
    description: The APB, TSADC & TSADC PHY resets, in that order.

  rockchip,grf:
    type: phandle
    required: true
    description: The GRF, which holds the sensor enable & analog trims.
```

## dts/bindings/spi/rockchip,rk3568-spi.yaml
```yaml
# SPDX-FileCopyrightText: Copyright The Zephyr Project Contributors
# SPDX-License-Identifier: Apache-2.0

description: |
  Rockchip RK3568 SPI controller, the RK3066 generation of the Rockchip SPI,
  with two native chip selects & 64-entry FIFOs.

  The driver switches the controller's clock to xin24m in the CRU that owns
  the resets, so SCLK is 24 MHz divided by an even number, at most 12 MHz.

compatible: "rockchip,rk3568-spi"

include: [spi-controller.yaml, pinctrl-device.yaml, reset-device.yaml]

properties:
  reg:
    required: true

  interrupts:
    required: true

  pinctrl-0:
    required: true

  pinctrl-names:
    required: true

  resets:
    required: true
    description: The APB reset & the controller reset, in that order.
```
